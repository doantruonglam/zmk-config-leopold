## config/boards/arm/filco/Kconfig.board
```kconfig
# Zaphod board configuration

# Copyright (c) 2020 Pete Johanson
# SPDX-License-Identifier: MIT

config BOARD_FILCO
	bool "Filco"
	depends on SOC_NRF52840_QIAA
```
